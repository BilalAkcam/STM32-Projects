# file: 22_deneme_2.ioc
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Mcu.Family=STM32F4
Mcu.Name=STM32F446R(C-E)Tx
Mcu.Package=LQFP64
NVIC.PriorityGroup=NVIC_PRIORITYGROUP_4
PA13.Mode=Serial_Wire
PA13.Signal=SYS_JTMS-SWDIO
PA14.Mode=Serial_Wire
PA14.Signal=SYS_JTCK-SWCLK
PH0-OSC_IN.Mode=HSE-External-Oscillator
PH0-OSC_IN.Signal=RCC_OSC_IN
PH1-OSC_OUT.Mode=HSE-External-Oscillator
PH1-OSC_OUT.Signal=RCC_OSC_OUT
ProjectManager.HeapSize=0x200
ProjectManager.StackSize=0x400
ProjectManager.TargetToolchain=STM32CubeIDE
RCC.CortexFreq_Value=16000000
RCC.USBFreq_Value=96000000
RCC.VCOOutputFreq_Value=192000000
board=custom

// file: Core/Src/main.c
/* USER CODE BEGIN Header */
/*	###################################################################################

 			 	 	 Stm32 ile KS0108 GRAFIK LCD'ye KARAKTER ve GORSEL YAZDIRMA

 				 							12.08.2022

 ==>> MAIN.c'de KULLANILAN ANA FONKSIYONLAR:

   -->EKRANA KARAKTER veya GORSEL  CIZDIRMEK: draw_ks0108(); fonksiyonuna font.h dosyasindaki bitmap dizisi atanarak kullanilir.

   -->EKRANA KARAKTER YAZDIRMA (Iki asamada yazdirilir):

   	  1) gotoxy_ks0108(x,y); fonksiyonu kullanilarak karakterin x ekseni ve y eksenindeki konumu belirlenir.
  	  2) puts_ks0108("MERHABA ENDUSTRIYEL ELEKTRIK"); ile yazdirma islemi gerceklestirilir.

   -->Bir karakter yazdirilirken maksimum 5 adet sutun 7 adet satir  kullanilir ve her sutundaki hucre arzu edilen karaktere gore
  	binary olarak set edilir ve boylece her bir 5'leme 1 karaktere karsilik gelir.

	#######################################################################################	*/
/* USER CODE END Header */
#include "main.h"

/* USER CODE BEGIN Includes */
#include "STM32F4xx.h"
#include "ks0108.h"
#include "font.h"
#include "delay.h"

/* USER CODE END Includes */

void SystemClock_Config(void);
static void MX_GPIO_Init(void);

int main(void)
{

  /* MCU Configuration--------------------------------------------------------*/

  /* Reset of all peripherals, Initializes the Flash interface and the Systick. */
  HAL_Init();

  /* Configure the system clock */
  SystemClock_Config();

  /* Initialize all configured peripherals */
  MX_GPIO_Init();
  /* USER CODE BEGIN 2 */
  init_ks0108();

  /* USER CODE END 2 */

  /* Infinite loop */
  while (1)
  {

    /* USER CODE BEGIN 3 */

		draw_ks0108(endustriyel);
		HAL_Delay(50);
		draw_ks0108(endustriyel2);
		HAL_Delay(50);
		draw_ks0108(endustriyel3);
		HAL_Delay(50);
		draw_ks0108(endustriyel4);
		HAL_Delay(50);
		draw_ks0108(endustriyel5);
		HAL_Delay(50);
		draw_ks0108(endustriyel6);
		HAL_Delay(75);
		draw_ks0108(endustriyel7);
		HAL_Delay(3000);
		draw_ks0108(TableTurkiye);
		HAL_Delay(3000);
		draw_ks0108(jake);
		HAL_Delay(3000);
		draw_ks0108(clear);
		HAL_Delay(3000);

		gotoxy_ks0108(1,3);
		puts_ks0108(" > < [ ] { } % merhaba") ;

		HAL_Delay(5000);

  }
  /* USER CODE END 3 */
}

void SystemClock_Config(void)
{
  RCC_OscInitTypeDef RCC_OscInitStruct = {0};
  RCC_ClkInitTypeDef RCC_ClkInitStruct = {0};

  /** Configure the main internal regulator output voltage
  */
  __HAL_RCC_PWR_CLK_ENABLE();
  __HAL_PWR_VOLTAGESCALING_CONFIG(PWR_REGULATOR_VOLTAGE_SCALE3);

  /** Initializes the RCC Oscillators according to the specified parameters
  * in the RCC_OscInitTypeDef structure.
  */
  RCC_OscInitStruct.OscillatorType = RCC_OSCILLATORTYPE_HSI;
  RCC_OscInitStruct.HSIState = RCC_HSI_ON;
  RCC_OscInitStruct.HSICalibrationValue = RCC_HSICALIBRATION_DEFAULT;
  RCC_OscInitStruct.PLL.PLLState = RCC_PLL_NONE;
  if (HAL_RCC_OscConfig(&RCC_OscInitStruct) != HAL_OK)
  {
    Error_Handler();
  }

  /** Initializes the CPU, AHB and APB buses clocks
  */
  RCC_ClkInitStruct.ClockType = RCC_CLOCKTYPE_HCLK|RCC_CLOCKTYPE_SYSCLK
                              |RCC_CLOCKTYPE_PCLK1|RCC_CLOCKTYPE_PCLK2;
  RCC_ClkInitStruct.SYSCLKSource = RCC_SYSCLKSOURCE_HSI;
  RCC_ClkInitStruct.AHBCLKDivider = RCC_SYSCLK_DIV1;
  RCC_ClkInitStruct.APB1CLKDivider = RCC_HCLK_DIV1;
  RCC_ClkInitStruct.APB2CLKDivider = RCC_HCLK_DIV1;

  if (HAL_RCC_ClockConfig(&RCC_ClkInitStruct, FLASH_LATENCY_0) != HAL_OK)
  {
    Error_Handler();
  }
}

static void MX_GPIO_Init(void)
{

  /* GPIO Ports Clock Enable */
  __HAL_RCC_GPIOH_CLK_ENABLE();
  __HAL_RCC_GPIOA_CLK_ENABLE();

}

void Error_Handler(void)
{
  __disable_irq();
  while (1)
  {
  }
}
